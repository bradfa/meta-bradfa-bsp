## conf/layer.conf
```bitbake
# We have a conf and classes directory, add to BBPATH
BBPATH .= ":${LAYERDIR}"
# We have recipes-* directories, add to BBFILES
BBFILES += " \
	${LAYERDIR}/recipes-*/*/*.bb \
	${LAYERDIR}/recipes-*/*/*.bbappend \
	"

BBFILE_COLLECTIONS += "bradfa-bsp"
BBFILE_PATTERN_bradfa-bsp = "^${LAYERDIR}/"
BBFILE_PRIORITY_bradfa-bsp = "6"

# This should only be incremented on significant changes that will
# cause compatibility issues with other layers
LAYERVERSION_bradfa-bsp= "1"
```

## conf/machine/bbb.conf
```bitbake
#@TYPE: Machine
#@NAME: bbb
#@DESCRIPTION: Machine configuration for BeagleBone Black

EXTRA_IMAGEDEPENDS += "u-boot"

include conf/machine/include/tune-cortexa8.inc

IMAGE_FSTYPES = "tar.gz"

SERIAL_CONSOLE = "115200 ttyO0"

PREFERRED_PROVIDER_virtual/kernel = "linux-mainline"

KERNEL_IMAGETYPE = "zImage"

KERNEL_DEVICETREE = "am335x-boneblack.dtb"
KERNEL_EXTRA_ARGS = "LOADADDR=${UBOOT_ENTRYPOINT}"
KBUILD_DEFCONFIG_bbb = "omap2plus_defconfig"

MODULE_TARBALL_DEPLOY = "0"

SPL_BINARY = "MLO"
UBOOT_SUFFIX = "img"
UBOOT_MACHINE = "am335x_boneblack_defconfig"
UBOOT_ENTRYPOINT = "0x80008000"
UBOOT_LOADADDRESS = "0x80008000"

MACHINE_FEATURES = ""

IMAGE_BOOT_FILES ?= "u-boot.${UBOOT_SUFFIX} MLO"
```
